## app/src/modules/cloud/Kconfig.cloud
```kconfig
#
# Copyright (c) 2025
#
# SPDX-License-Identifier: LicenseRef-Nordic-5-Clause
#

menuconfig APP_CLOUD
	bool "Cloud REST module"
	default y

if APP_CLOUD

# These two options are referenced by cloud.h and must remain defined.
config APP_CLOUD_PAYLOAD_BUFFER_MAX_SIZE
	int "Payload maximum buffer size"
	default 128
	help
	  Maximum size of the cloud_payload buffer used when routing JSON payloads
	  through cloud_chan.  Not used for the actual HTTP body in REST mode.

config APP_CLOUD_SHADOW_RESPONSE_BUFFER_MAX_SIZE
	int "Shadow response buffer size"
	default 512
	help
	  Maximum size of the cloud_shadow_response buffer.  Not used in REST
	  mode; kept so that cloud.h compiles without changes.

# --------------------------------------------------------------------------
# REST server configuration
# --------------------------------------------------------------------------

config APP_CLOUD_REST_SERVER_HOST
	string "REST API server hostname"
	default "dev.tracking.rideyourstyle.ch"
	help
	  Hostname of the tracking REST API server.

config APP_CLOUD_REST_SERVER_PORT
	int "REST API server port"
	default 80
	help
	  TCP port of the tracking REST API server (80 for HTTP, 443 for HTTPS).

config APP_CLOUD_REST_API_PATH
	string "REST API tracker path prefix"
	default "/v1/trackers"
	help
	  URL path prefix for the tracker endpoint. The tracker ID is appended
	  automatically: PUT {prefix}/{tracker_id}

config APP_CLOUD_REST_TRACKER_ID_FALLBACK
	string "Fallback tracker ID"
	default "nrf-tracker-unknown"
	help
	  Tracker ID used when hw_id_get() fails to retrieve the modem IMEI.
	  Normally the IMEI is used automatically.

config APP_CLOUD_REST_TRACKER_ID_OVERRIDE
	bool "Override tracker ID"
	help
	  If enabled, APP_CLOUD_REST_TRACKER_ID_FALLBACK is always used as the
	  tracker ID, ignoring the modem IMEI. Useful for testing.

config APP_CLOUD_REST_API_KEY
	string "API key for request authentication"
	default ""
	help
	  If non-empty, this value is sent as an 'X-Api-Key: <value>' header
	  with every HTTP request. Leave empty to disable API key authentication.

config APP_CLOUD_REST_TLS
	bool "Use TLS (HTTPS) for REST API"
	default n
	help
	  Enable TLS for the REST cloud module. On nRF91x1 the modem handles
	  TLS as hardware offload — no software TLS stack is needed.
	  Set APP_CLOUD_REST_SERVER_PORT=443 when enabling this option.
	  Peer certificate verification is disabled (suitable for dev/test without
	  provisioning a CA certificate into the modem).

config APP_CLOUD_REST_GNSS_MIN_ACCURACY_METERS
	int "Minimum GNSS accuracy to send a position (0 = send always)"
	default 0
	help
	  If non-zero, positions with an accuracy (1-sigma) worse than this
	  value in metres are discarded and not sent to the server.
	  Example: 30 means only fixes with accuracy <= 30 m are sent.

config APP_CLOUD_REST_HTTP_TIMEOUT_SECONDS
	int "HTTP request timeout in seconds"
	default 30
	help
	  Maximum time to wait for a complete HTTP response before giving up.

config APP_CLOUD_REST_JSON_BUFFER_SIZE
	int "JSON payload buffer size in bytes"
	default 512
	help
	  Size of the static buffer used to hold the JSON request body.

# --------------------------------------------------------------------------
# Thread / watchdog
# --------------------------------------------------------------------------

config APP_CLOUD_THREAD_STACK_SIZE
	int "Thread stack size"
	default 4096
	help
	  Stack size for the cloud module thread.  Needs to accommodate DNS
	  resolution and the HTTP send/receive buffers that are stack-allocated
	  in send_position().

config APP_CLOUD_MESSAGE_QUEUE_SIZE
	int "Message queue size"
	default 5
	help
	  ZBus subscriber message queue size.

config APP_CLOUD_WATCHDOG_TIMEOUT_SECONDS
	int "Watchdog timeout in seconds"
	default 180
	help
	  Timeout for the cloud module task watchdog.  Must be greater than
	  APP_CLOUD_MSG_PROCESSING_TIMEOUT_SECONDS.

config APP_CLOUD_MSG_PROCESSING_TIMEOUT_SECONDS
	int "Maximum message processing time in seconds"
	default 120
	help
	  Maximum time allowed to process a single message (e.g. the duration
	  of a full DNS + TCP connect + HTTP POST round-trip).  Must be smaller
	  than APP_CLOUD_WATCHDOG_TIMEOUT_SECONDS.

module = APP_CLOUD
module-str = Cloud
source "subsys/logging/Kconfig.template.log_config"

endif # APP_CLOUD
```

## app/src/modules/motion/Kconfig.motion
```kconfig
#
# Copyright (c) 2025 Nordic Semiconductor ASA
#
# SPDX-License-Identifier: LicenseRef-Nordic-5-Clause
#

menu "Motion"

config APP_MOTION
	bool "Motion detection module (ADXL367)"
	depends on ADXL367
	help
	  Enable snapshot-based motion detection using the on-board ADXL367
	  low-power accelerometer. Called once per sampling cycle at the end
	  of each GNSS search (LOCATION_SEARCH_DONE). Compares consecutive
	  ACC snapshots — a stationary device reads near-zero delta regardless
	  of mounting angle.

module = APP_MOTION
module-str = Motion
source "subsys/logging/Kconfig.template.log_config"

endmenu # Motion
```
